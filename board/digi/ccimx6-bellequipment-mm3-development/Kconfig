## board/digi/ccimx6-bellequipment-mm3-development/Kconfig
```kconfig
if TARGET_CCIMX6_BELLEQUIPMENT_MM3_DEVELOPMENT

config SYS_BOARD
	default "ccimx6-bellequipment-mm3-development"

config SYS_VENDOR
	default "digi"

config SYS_SOC
	default "mx6"

config SYS_CONFIG_NAME
	default "ccimx6-bellequipment-mm3-development"

endif
```

## configs/ccimx6-bellequipment-mm3-development_defconfig
```kconfig
CONFIG_ARM=y
CONFIG_ARCH_MX6=y
CONFIG_SECURE_BOOT=y
CONFIG_TARGET_CCIMX6_BELLEQUIPMENT_MM3_DEVELOPMENT=y
CONFIG_DEFAULT_DEVICE_TREE="imx6q-ccimx6-bellequipment-mm3-development"
CONFIG_DISTRO_DEFAULTS=y
CONFIG_OF_BOARD_SETUP=y
CONFIG_SYS_EXTRA_OPTIONS="IMX_CONFIG=board/digi/ccimx6/ccimx6q1GB.cfg,MX6Q,DDR_MB=1024"
CONFIG_BOOTDELAY=1
CONFIG_SILENT_CONSOLE=y
# CONFIG_SILENT_CONSOLE_UPDATE_ON_SET is not set
# CONFIG_CMD_IMLS is not set
# CONFIG_CMD_IMLS is not set
# CONFIG_CMD_BMP is not set
CONFIG_CMD_MEMTEST=y
CONFIG_CMD_GPT=y
CONFIG_CMD_MMC=y
CONFIG_CMD_I2C=y
CONFIG_CMD_USB=y
CONFIG_CMD_GPIO=y
CONFIG_CMD_CACHE=y
CONFIG_CMD_TIME=y
CONFIG_CMD_EXT4_WRITE=y
# CONFIG_ISO_PARTITION is not set
CONFIG_PARTITION_TYPE_GUID=y
CONFIG_OF_CONTROL=y
CONFIG_RNG_SW_TEST=y
CONFIG_DM_GPIO=y
CONFIG_PHYLIB=y
CONFIG_PHY_MICREL=y
CONFIG_PHY_MICREL_KSZ8XXX=y
CONFIG_IMX_THERMAL=y
CONFIG_USB=y
CONFIG_USB_EHCI_HCD=y
CONFIG_USB_STORAGE=y
CONFIG_USB_GADGET=y
CONFIG_CI_UDC=y
CONFIG_USB_GADGET_DOWNLOAD=y
CONFIG_G_DNL_MANUFACTURER="FSL"
CONFIG_G_DNL_VENDOR_NUM=0x0525
CONFIG_G_DNL_PRODUCT_NUM=0xa4a5
CONFIG_RMII=y
#CONFIG_MXC_GPIO=y
#CONFIG_CMD_MII=y
#CONFIG_ENET_RMII=y
#CONFIG_FEC_ENET=y
#CONFIG_MXC_FEC=y
#CONFIG_FEC1_PHY=-1
#CONFIG_FEC1_PHY_ADDR=-1
#CONFIG_FEC1_MIIBASE=-1
#CONFIG_FEC1_PINMUX=-1
#CONFIG_ETH_PRIME=y
#CONFIG_ETHER_ON_FEC1=y
```
